## meta-agl-drm-lease/conf/layer.conf
```bitbake
# We have a conf and classes directory, add to BBPATH
BBPATH .= ":${LAYERDIR}"

# We have recipes-* directories, add to BBFILES
BBFILES += "${LAYERDIR}/recipes-*/*/*.bb ${LAYERDIR}/recipes-*/*/*.bbappend"

BBFILE_COLLECTIONS += "agl-drm-lease"
BBFILE_PATTERN_agl-drm-lease = "^${LAYERDIR}/"
BBFILE_PRIORITY_agl-drm-lease = "80"

BBFILES_DYNAMIC += " \
    rcar-gen3:${LAYERDIR}/dynamic-layers/meta-rcar-gen3/*/*/*.bb \
    rcar-gen3:${LAYERDIR}/dynamic-layers/meta-rcar-gen3/*/*/*.bbappend \
    qt6-layer:${LAYERDIR}/dynamic-layers/meta-qt6/*/*/*.bb \
    qt6-layer:${LAYERDIR}/dynamic-layers/meta-qt6/*/*/*.bbappend \
    raspberrypi:${LAYERDIR}/dynamic-layers/meta-raspberrypi/*/*/*.bb \
    raspberrypi:${LAYERDIR}/dynamic-layers/meta-raspberrypi/*/*/*.bbappend \
    aglcore:${LAYERDIR}/dynamic-layers/meta-agl-core/*/*/*.bb \
    aglcore:${LAYERDIR}/dynamic-layers/meta-agl-core/*/*/*.bbappend \
"

# This should only be incremented on significant changes that will
# cause compatibility issues with other layers
LAYERVERSION_agl-drm-lease = "1"

LAYERDEPENDS_agl-drm-lease = "core"
LAYERSERIES_COMPAT_agl-drm-lease = "langdale"
```

## meta-agl-flutter/conf/layer.conf
```bitbake
# We have a conf and classes directory, add to BBPATH
BBPATH .= ":${LAYERDIR}"

# We have recipes-* directories, add to BBFILES
BBFILES += "${LAYERDIR}/recipes-*/*/*.bb \
            ${LAYERDIR}/recipes-*/*/*.bbappend"

BBFILE_COLLECTIONS += "agl-flutter-layer"
BBFILE_PATTERN_agl-flutter-layer = "^${LAYERDIR}/"
BBFILE_PRIORITY_agl-flutter-layer = "61"

LAYERVERSION_agl-flutter-layer = "1"
LAYERDEPENDS_agl-flutter-layer = "core flutter-layer"
LAYERRECOMMENDS_agl-flutter-layer = "flutter-apps-layer"
LAYERSERIES_COMPAT_agl-flutter-layer = "scarthgap"

BBFILES_DYNAMIC += " \
    flutter-apps-layer:${LAYERDIR}/dynamic-layers/flutter-apps-layer/*/*/*/*.bbappend \
"
```

## meta-agl-ic-container/conf/layer.conf
```bitbake
# We have a conf and classes directory, add to BBPATH
BBPATH =. "${LAYERDIR}:"

# We have recipes-* directories, add to BBFILES
BBFILES += "${LAYERDIR}/recipes-*/*/*.bb \
            ${LAYERDIR}/recipes-*/*/*.bbappend"

BBFILE_COLLECTIONS += "aglcontainermc"
BBFILE_PATTERN_aglcontainermc = "^${LAYERDIR}/"
BBFILE_PRIORITY_aglcontainermc = "100"

BBFILES_DYNAMIC += " \
    rcar-gen3:${LAYERDIR}/dynamic-layers/meta-rcar-gen3/*/*/*.bb \
    rcar-gen3:${LAYERDIR}/dynamic-layers/meta-rcar-gen3/*/*/*.bbappend \
    raspberrypi:${LAYERDIR}/dynamic-layers/meta-raspberrypi/*/*/*.bb \
    raspberrypi:${LAYERDIR}/dynamic-layers/meta-raspberrypi/*/*/*.bbappend \
    rockchip:${LAYERDIR}/dynamic-layers/meta-rockchip/*/*/*.bb \
    rockchip:${LAYERDIR}/dynamic-layers/meta-rockchip/*/*/*.bbappend \
    selinux:${LAYERDIR}/dynamic-layers/meta-selinux/*/*/*.bb \
    selinux:${LAYERDIR}/dynamic-layers/meta-selinux/*/*/*.bbappend \
"

LAYERSERIES_COMPAT_aglcontainermc = "scarthgap"
LAYERDEPENDS_aglcontainermc = "aglcore qt6-layer openembedded-layer virtualization-layer agl-drm-lease meta-pipewire"
```

## meta-agl-ic-container/wic/agl-ic-container-bootpart-uuid-demo.wks
```
# short-description: Create SD card image with a boot partition
# long-description: Creates a partitioned SD card image. Boot files
# are located in the first vfat partition.

part /boot --source bootimg-partition --fstype=vfat --label boot --use-uuid --active --align 4 --size 16
part / --source rootfs --fstype=ext4 --label host --align 4096 --size 1024
part --source rawcopy --sourceparams="file=guest-image-cluster-demo.ext4"
part --source rawcopy --sourceparams="file=guest-image-ivi-demo.ext4"
part --source rawcopy --sourceparams="file=agl-ivi-demo-qt.ext4"
part --source rawcopy --sourceparams="file=agl-ivi-demo-flutter.ext4"
```

## meta-agl-ic-container/wic/agl-ic-container-noloader.wks
```
# short-description: Single partition rootfs with UUID and no bootloader
# long-description: Creates a partitioned image with a single partition in
# use and does not contain a bootloader.

bootloader --ptable gpt
part / --source rootfs --fstype=ext4 --label host --align 4096 --size 1024
part --source rawcopy --sourceparams="file=guest-image-cluster-demo.ext4"
part --source rawcopy --sourceparams="file=guest-image-ivi-demo.ext4"
```

## meta-agl-ic-container/wic/agl-ic-container-rockchip.wks
```
# short-description: Single partition rootfs with UUID and no bootloader
# long-description: Creates a partitioned image with a single partition in
# use and does not contain a bootloader.

bootloader --ptable gpt
part --source rawcopy --sourceparams="file=idblock.img" --align 32 --no-table
part --source rawcopy --sourceparams="file=uboot.img" --part-name uboot --align 8192
part --source rawcopy --sourceparams="file=boot.img" --part-name boot
part / --source rootfs --fstype=ext4 --label host --align 4096 --size 1024
part --source rawcopy --sourceparams="file=guest-image-cluster-demo.ext4"
part --source rawcopy --sourceparams="file=guest-image-ivi-demo.ext4"
```

## meta-agl-jailhouse/conf/layer.conf
```bitbake
# We have a conf and classes directory, append to BBPATH
BBPATH .= ":${LAYERDIR}"

# We have a recipes directory, add to BBFILES
BBFILES += "${LAYERDIR}/recipes*/*/*.bb ${LAYERDIR}/recipes*/*/*.bbappend"

BBFILE_COLLECTIONS += "agl-jailhouse"
BBFILE_PATTERN_agl-jailhouse := "^${LAYERDIR}/"
BBFILE_PRIORITY_agl-jailhouse = "61"

# This should only be incremented on significant changes that will
# cause compatibility issues with other layers
LAYERVERSION_agl-jailhouse = "1"
LAYERSERIES_COMPAT_agl-jailhouse = "langdale mickledore"

# This is only needed for Raspberry Pi
# TODO: can this be expressed dynamically?
LAYERDEPENDS_agl-jailhouse = "meta-arm meta-arm-toolchain"

BBFILES_DYNAMIC += " \
    raspberrypi:${LAYERDIR}/dynamic-layers/raspberrypi/*/*/*.bbappend \
"
```

## meta-agl-rdp/conf/layer.conf
```bitbake
# We have a conf and classes directory, add to BBPATH
BBPATH .= ":${LAYERDIR}"

# We have recipes-* directories, add to BBFILES
BBFILES += "${LAYERDIR}/recipes-*/*/*.bb \
	${LAYERDIR}/recipes-*/*/*.bbappend"

BBFILE_COLLECTIONS += "meta-aglrdp"
BBFILE_PATTERN_meta-aglrdp = "^${LAYERDIR}/"
BBFILE_PRIORITY_meta-aglrdp = "8"

LAYERSERIES_COMPAT_meta-aglrdp= "scarthgap"
```

## meta-agl-test/conf/layer.conf
```bitbake
#We have a conf and classes directory, add to BBPATH
BBPATH .= ":${LAYERDIR}"

# We have recipes-* directories, add to BBFILES
BBFILES += "${LAYERDIR}/recipes-*/*/*.bb ${LAYERDIR}/recipes-*/*/*.bbappend"

BBFILE_COLLECTIONS += "agl-test"
BBFILE_PATTERN_agl-test = "^${LAYERDIR}/"

# This should only be incremented on significant changes that will
# cause compatibility issues with other layers
LAYERVERSION_agl-test = "1"

LAYERSERIES_COMPAT_agl-test = "langdale mickledore"
```

## meta-agl-wireless-monitor/conf/layer.conf
```bitbake
#We have a conf and classes directory, add to BBPATH
BBPATH .= ":${LAYERDIR}"

# We have recipes-* directories, add to BBFILES
BBFILES += "${LAYERDIR}/recipes-*/*/*.bb ${LAYERDIR}/recipes-*/*/*.bbappend"

BBFILE_COLLECTIONS += "agl-wireless-monitor"
BBFILE_PATTERN_agl-wireless-monitor = "^${LAYERDIR}/"
BBFILE_PRIORITY_agl-drm-lease = "100"

# This should only be incremented on significant changes that will
# cause compatibility issues with other layers
LAYERVERSION_agl-wireless-monitor = "1"

LAYERSERIES_COMPAT_agl-wireless-monitor = "scarthgap"
```

## meta-bosch-sw/conf/layer.conf
```bitbake
# We have a conf and classes directory, add to BBPATH
BBPATH .= ":${LAYERDIR}"

# We have recipes-* directories, add to BBFILES
BBFILES += "${LAYERDIR}/recipes-*/*/*.bb ${LAYERDIR}/recipes-*/*/*.bbappend"

BBFILE_COLLECTIONS += "bosch_sw"
BBFILE_PATTERN_bosch_sw = "^${LAYERDIR}/"
BBFILE_PRIORITY_bosch_sw = "1"

# This should only be incremented on significant changes that will
# cause compatibility issues with other layers
LAYERVERSION_bosch_sw = "1"

LAYERDEPENDS_bosch_sw = "core"

LAYERSERIES_COMPAT_bosch_sw = "dunfell hardknott"
```

## meta-egvirt/conf/layer.conf
```bitbake
# We have a conf and classes directory, add to BBPATH
BBPATH .= ":${LAYERDIR}"

# We have recipes-* directories, add to BBFILES
BBFILES += "${LAYERDIR}/recipes-*/*/*.bb ${LAYERDIR}/recipes-*/*/*.bbappend"

BBFILE_COLLECTIONS += "egvirt"
BBFILE_PATTERN_egvirt = "^${LAYERDIR}/"
BBFILE_PRIORITY_egvirt = "61"

BBFILES_DYNAMIC += " \
    rcar-gen3:${LAYERDIR}/dynamic-layers/rcar-gen3/*/*/*.bbappend \
    raspberrypi:${LAYERDIR}/dynamic-layers/raspberrypi/*/*/*.bbappend \
"

# This should only be incremented on significant changes that will
# cause compatibility issues with other layers
LAYERVERSION_egvirt = "1"
LAYERSERIES_COMPAT_egvirt = "scarthgap"

LAYERDEPENDS_egvirt = "core clang-layer filesystems-layer"
```

## meta-offline-voice-agent/conf/layer.conf
```bitbake
# We have a conf and classes directory, add to BBPATH
BBPATH .= ":${LAYERDIR}"

# We have recipes-* directories, add to BBFILES
BBFILES += "${LAYERDIR}/recipes-*/*/*.bb \
            ${LAYERDIR}/recipes-*/*/*.bbappend"

BBFILE_COLLECTIONS += "meta-offline-voice-agent"
BBFILE_PATTERN_meta-offline-voice-agent = "^${LAYERDIR}/"
BBFILE_PRIORITY_meta-offline-voice-agent = "65"

LAYERDEPENDS_meta-offline-voice-agent = "core"
LAYERSERIES_COMPAT_meta-offline-voice-agent = "langdale"

BBFILES_DYNAMIC += " \
    agldemo:${LAYERDIR}/dynamic-layers/meta-agl-demo/*/*/*.bb \
    agldemo:${LAYERDIR}/dynamic-layers/meta-agl-demo/*/*/*.bbappend \
"
```

## meta-uhmi/conf/layer.conf
```bitbake
# We have a conf and classes directory, add to BBPATH
BBPATH .= ":${LAYERDIR}"

# We have recipes-* directories, add to BBFILES
BBFILES += "${LAYERDIR}/recipes-*/*/*.bb \
	${LAYERDIR}/recipes-*/*/*.bbappend"

BBFILE_COLLECTIONS += "meta-uhmi"
BBFILE_PATTERN_meta-uhmi = "^${LAYERDIR}/"
BBFILE_PRIORITY_meta-uhmi = "8"

BBFILES_DYNAMIC += " \
    rcar-gen3:${LAYERDIR}/dynamic-layers/rcar-gen3/*/*/*.bbappend \
    raspberrypi:${LAYERDIR}/dynamic-layers/raspberrypi/*/*/*.bbappend \
"

LAYERSERIES_COMPAT_meta-uhmi= "scarthgap"
```

## meta-uhmi/meta-agl-uhmi-demo/conf/layer.conf
```bitbake
# We have a conf and classes directory, add to BBPATH
BBPATH =. "${LAYERDIR}:"

# We have recipes-* directories, add to BBFILES
BBFILES += "${LAYERDIR}/recipes-*/*/*.bb \
            ${LAYERDIR}/recipes-*/*/*.bbappend"

BBFILE_COLLECTIONS += "agl-uhmi-demo-layer"
BBFILE_PATTERN_agl-uhmi-demo-layer = "^${LAYERDIR}/"
BBFILE_PRIORITY_agl-uhmi-demo-layer = "70"

LAYERSERIES_COMPAT_agl-uhmi-demo-layer = "scarthgap"

LAYERDEPENDS_agl-uhmi-demo-layer = "agldemo"
```

## meta-uhmi/meta-distributed-display-fw/conf/layer.conf
```bitbake
# We have a conf and classes directory, add to BBPATH
BBPATH .= ":${LAYERDIR}"

# We have recipes-* directories, add to BBFILES
BBFILES += "${LAYERDIR}/recipes-*/*/*.bb \
	${LAYERDIR}/recipes-*/*/*.bbappend"

BBFILE_COLLECTIONS += "meta-distributed-display-fw"
BBFILE_PATTERN_meta-distributed-display-fw = "^${LAYERDIR}/"
BBFILE_PRIORITY_meta-distributed-display-fw = "8"

LAYERSERIES_COMPAT_meta-distributed-display-fw= "scarthgap"
```

## meta-uhmi/meta-rvgpu/conf/layer.conf
```bitbake
# We have a conf and classes directory, add to BBPATH
BBPATH .= ":${LAYERDIR}"

# We have recipes-* directories, add to BBFILES
BBFILES += "${LAYERDIR}/recipes-*/*/*.bb \
	${LAYERDIR}/recipes-*/*/*.bbappend"

BBFILE_COLLECTIONS += "meta-rvgpu"
BBFILE_PATTERN_meta-rvgpu = "^${LAYERDIR}/"
BBFILE_PRIORITY_meta-rvgpu = "8"

BBFILES_DYNAMIC += " \
    rcar-gen3:${LAYERDIR}/dynamic-layers/rcar-gen3/*/*/*.bbappend \
    raspberrypi:${LAYERDIR}/dynamic-layers/raspberrypi/*/*/*.bbappend \
"

LAYERSERIES_COMPAT_meta-rvgpu= "scarthgap"
```
